## arch/arm/mach-axera/Kconfig
```kconfig
# SPDX-License-Identifier: GPL-2.0
menuconfig ARCH_AXERA
	bool "Axera SOC Support"
	depends on ARCH_MULTI_V7
	select ARM_GIC
	select NO_IOPORT_MAP

if ARCH_AXERA

menu "Axera platform type"

config ARCH_AX620E
	bool "Axera AX620X family"
	depends on ARCH_MULTI_V7
	select CACHE_L2X0
	select HAVE_ARM_SCU if SMP
	select HAVE_ARM_TWD if SMP
	select PINCTRL
	select PINCTRL_SINGLE
	help
	  Support for Axera AX620E SoC family

config CLK_AUX_SUSPEND_DISABLE
	bool "clk aux will be disabled during sleep"
	depends on ARCH_AX620E
	default y
	help
	  Used to disable clk aux during sleep or clk aux always work.

endmenu

endif
```

## drivers/clk/axera/Kconfig
```kconfig
config COMMON_CLK_AXERA
	bool
	help
	  Axera SoCs' clock support.

config COMMON_CLK_AX620E
	bool "Clock driver for Axera AX620E"
	depends on ARCH_AXERA || COMPILE_TEST
	select COMMON_CLK_AXERA
	default ARCH_AXERA
	help
	  This driver supports Axera AX620E basic clocks.
```

## drivers/crypto/axera/Kconfig
```kconfig
# SPDX-License-Identifier: GPL-2.0
if CRYPTO_DEV_AXERA
config AX_CIPHER_CRYPTO
	bool "Support for axera cipher crypto Engine"
	depends on (OF || COMPILE_TEST) && HAS_IOMEM
	select CRYPTO_SKCIPHER
	select CRYPTO_AKCIPHER
	select HW_RANDOM
	select CRYPTO_ECB
	select CRYPTO_CBC
	select CRYPTO_DES
	select CRYPTO_AES
	select CRYPTO_LIB_AES
	select CRYPTO_LIB_DES
	select CRYPTO_USER_API_HASH
	select CRYPTO_USER_API_SKCIPHER
	select CRYPTO_USER_API_RNG
    select CRYPTO_RSA
	help
	  Support for axera cipher crypto Engine.

config AX_CIPHER_MISC
	bool "Support for axera cipher misc api"
	help
	  Support for axera cipher misc api.
endif
```

## drivers/gpu/arm/Kconfig
```kconfig
# SPDX-License-Identifier: GPL-2.0
if ARM64 || ARM
source "drivers/gpu/arm/mali400/mali/Kconfig"
source "drivers/gpu/arm/mali400/ump/Kconfig"
endif

if ARM64 || X86_64 || !64BIT
choice
	prompt "Mali Midgard driver"

config MALI_MIDGARD_FOR_ANDROID
	bool "Mali Midgard for Android"

config MALI_MIDGARD_FOR_LINUX
	bool "Mali Midgard for Linux only"

endchoice

source "drivers/gpu/arm/midgard/Kconfig"

choice
	prompt "Mali bifrost driver"

config MALI_BIFROST_FOR_ANDROID
	bool "Mali Bifrost for Android"

config MALI_BIFROST_FOR_LINUX
	bool "Mali Bifrost for Linux only"

endchoice

source "drivers/gpu/arm/bifrost/Kconfig"

if MALI_KUTF
choice
	prompt "Mali kutf driver"
	default MALI_MIDGARD_KUTF if MALI_MIDGARD
	default MALI_BIFROST_KUTF if !MALI_MIDGARD

config MALI_MIDGARD_KUTF
        bool "Mali Midgard kutf"
	depends on MALI_MIDGARD

config MALI_BIFROST_KUTF
        bool "Mali Bifrost kutf"
	depends on MALI_BIFROST

endchoice
endif

endif
```

## drivers/gpu/drm/axera/Kconfig
```kconfig
config DRM_AXERA
	tristate "DRM Support for Axera Display Controller"
	depends on DRM && OF && (ARM || ARM64)
	select DRM_KMS_HELPER
	select DRM_KMS_CMA_HELPER
	select DRM_GEM_CMA_HELPER
	select DRM_PANEL
	select VIDEOMODE_HELPERS
	select DRM_MIPI_DSI
	select DRM_DW_MIPI_DSI
	select DRM_PANEL_SIMPLE_AXERA
```

## drivers/pfe_ctrl/Kconfig
```kconfig
#
# MindSpeed pfe support (added by Andy, 2014/07/08)
#

config PFE_CTRL
        tristate "MindSpeed pfe support"
        default m
        ---help---
                MindSpeed pfe kernel module
                (copied from "MindSpeed_OpenWRT/sdk-comcerto-openwrt-c2k_nas_3.1-rc2/package/mindspeed/pfe_ctrl")

config PFE_WIFI_OFFLOAD
	bool "pfe wifi offload"
	default n
	depends on PFE_CTRL
	help
		Enable pfe wifi offload
```

## drivers/pinctrl/axera/Kconfig
```kconfig
config PINCTRL_AXERA
	bool "AXERA pinctrl driver"
	depends on GPIOLIB
	select PINMUX
	select GENERIC_PINCONF
	select GENERIC_PINCTRL_GROUPS
	select GENERIC_PINMUX_FUNCTIONS
	help
	  Say Y here to enable the axera pinctrl driver

config PINCTRL_AX620E
	bool "AX620E pinctrl driver"
	depends on PINCTRL_AXERA
	help
	  Say Y here to enable the ax620e pinctrl driver
```

## drivers/platform/zyxel-nas/Kconfig
```kconfig
config ZYXEL_NAS_CONTROL
	bool "Zyxel nas-control driver"
	depends on OF_GPIO && (PLAT_ORION || ARCH_LS1024A)
	default y
	help
	  This driver supports controlling Zyxel NAS devices.

	  Say Y if you have a Zyxel NAS.

config ZYXEL_NAS_KEYS
	bool "Zyxel NAS keys driver"
	depends on ZYXEL_NAS_CONTROL
	default y
	help
	  This driver supports controlling the keys on Zyxel NAS devices.

	  Say Y if you have a Zyxel NAS.

config ZYXEL_NAS_LEDS
	bool "Zyxel NAS LEDs driver"
	depends on ZYXEL_NAS_CONTROL
	default y
	help
	  This driver supports controlling the LEDs on Zyxel NAS devices.

	  Say Y if you have a Zyxel NAS.

config ZYXEL_NAS_PWMS
	bool "Zyxel NAS pwms driver"
	depends on ZYXEL_NAS_CONTROL
	default y
	help
	  This driver supports controlling the pwms on Zyxel NAS devices.

	  Say Y if you have a Zyxel NAS.

config ZYXEL_HDD_EXTENSIONS
	bool "Zyxel HDD extensions"
	default n
	depends on SCSI=y && BLK_DEV_SD=y
	depends on ZYXEL_NAS_LEDS
	help
	  This option enables support for Zyxel HDD LEDs and disk status.

config ZYXEL_NAS_MCU
	bool "Zyxel MCU driver"
	depends on OF_GPIO && (PLAT_ORION || ARCH_LS1024A)
	default y
	help
	  This driver supports controlling the MCU on Zyxel NAS devices.

	  Say Y if you have a Zyxel NAS.
```

## drivers/reset/axera_reset/Kconfig
```kconfig
config AXERA_RESET_AX620E
	tristate "AX620E Reset Driver"
	depends on HAS_IOMEM
	select MFD_SYSCON
	default ARCH_AXERA
	help
	  Build the AX620E  reset driver.
```

## drivers/soc/axera/Kconfig
```kconfig
config  AX_HWINFO
	tristate "AX HWINFO Driver"
	help
		This enable HWINFO driver.

config AXERA_OSAL
	tristate "axera osal module api"
	default y
	help
		To use the axera platform, you need to enable this option to support the axera module Driver

config  AX_BWLIMITER
	tristate "AX BW Limiter Driver"
	help
		This enable BW Limiter driver.

config  AXERA_SYS_MAP
	tristate "AXERA_SYS_MAP"
	default y
	help
		Driver for map the ddr space at the user space.
		Map support cached type and uncached type memory map.

config AXERA_DW_APB_TIMER
	tristate "axera apb timer"
 	default m

config AXERA_PERIPH_TIMER32
	tristate "axera timer32"
 	default m

config AXERA_WAKE_TIMER
	tristate "axera wake timer"
 	default y

config AXERA_SLEEP_STATE
	tristate "axera slp state"
 	default y

config AXERA_HRTIMER
	tristate "axera hrtimer"
 	default y

config AXERA_OS_MEM
	tristate "axera os memory"
	default y

config  AXERA_MEMORY_DUMP
	tristate "AXERA_MEMORY_DUMP"
	select CRASH_CORE
	default n
	help
		This enable  AXERA_MEMORY_DUMP.

config  AX_GZIPD
	tristate "AX GZIPD Driver"
	help
		This enable AXERA GZIPD driver.

config AXERA_DISPLAY_DUMMY
	tristate "axera display dummy"
	depends on DRM=n
	default y

config AXERA_RISCV_DRV
	tristate "integrates riscv driver to linux kernel"
	help
		This integrates ax_riscv driver to linux kernel.
	default y

config AX_RISCV_LOAD_ROOTFS
	bool "riscv load rootfs"
	depends on AXERA_RISCV_DRV=y
	help
		This enable riscv load rootfs.
	default n

config AXERA_BUILDIN_PRVDRV
	bool "integrates ax private driver to linux kernel"
	help
		This integrates ax private driver to linux kernel.
	default n

config AXERA_BUILDIN_PRVDRV_CMM
	bool "integrates ax_cmm driver to linux kernel"
	depends on AXERA_BUILDIN_PRVDRV=y
	help
		This integrates ax_cmm driver to linux kernel.
	default n

config AXERA_BUILDIN_PRVDRV_SYS
	bool "integrates ax_sys driver to linux kernel"
	depends on AXERA_BUILDIN_PRVDRV=y
	help
		This integrates ax_sys driver to linux kernel.
	default n

config AXERA_BUILDIN_PRVDRV_POOL
	bool "integrates ax_pool driver to linux kernel"
	depends on AXERA_BUILDIN_PRVDRV=y
	help
		This integrates ax_pool driver to linux kernel.
	default n

config AXERA_BUILDIN_PRVDRV_BASE
	bool "integrates ax_base driver to linux kernel"
	depends on AXERA_BUILDIN_PRVDRV=y
	help
		This integrates ax_base driver to linux kernel.
	default n

config AXERA_BUILDIN_PRVDRV_MIPI_RX
	bool "integrates ax_mipi_rx driver to linux kernel"
	depends on AXERA_BUILDIN_PRVDRV=y
	help
		This integrates ax_mipi_rx driver to linux kernel.
	default n

config AXERA_BUILDIN_PRVDRV_MIPI_SWITCH
	bool "integrates ax_mipi_switch driver to linux kernel"
	depends on AXERA_BUILDIN_PRVDRV=y
	help
		This integrates ax_mipi_switch driver to linux kernel.
	default n

config AXERA_BUILDIN_PRVDRV_NPU
	bool "integrates ax_npu driver to linux kernel"
	depends on AXERA_BUILDIN_PRVDRV=y
	help
		This integrates ax_npu driver to linux kernel.
	default n

config AXERA_BUILDIN_PRVDRV_VO
	bool "integrates ax_vo driver to linux kernel"
	depends on AXERA_BUILDIN_PRVDRV=y
	help
		This integrates ax_vo driver to linux kernel.
	default n

config AXERA_BUILDIN_PRVDRV_IVPS
	bool "integrates ax_ivps driver to linux kernel"
	depends on AXERA_BUILDIN_PRVDRV=y
	help
		This integrates ax_ivps driver to linux kernel.
	default n

config AXERA_BUILDIN_PRVDRV_VPP
	bool "integrates ax_vpp driver to linux kernel"
	depends on AXERA_BUILDIN_PRVDRV=y
	help
		This integrates ax_vpp driver to linux kernel.
	default n

config AXERA_BUILDIN_PRVDRV_GDC
	bool "integrates ax_gdc driver to linux kernel"
	depends on AXERA_BUILDIN_PRVDRV=y
	help
		This integrates ax_gdc driver to linux kernel.
	default n

config AXERA_BUILDIN_PRVDRV_TDP
	bool "integrates ax_tdp driver to linux kernel"
	depends on AXERA_BUILDIN_PRVDRV=y
	help
		This integrates ax_tdp driver to linux kernel.
	default n

config AXERA_BUILDIN_PRVDRV_ISP
	bool "integrates ax_isp driver to linux kernel"
	depends on AXERA_BUILDIN_PRVDRV=y
	help
		This integrates ax_isp driver to linux kernel.
	default n

config AXERA_BUILDIN_PRVDRV_VCODEC
	bool "integrates vcodec driver to linux kernel"
	depends on AXERA_BUILDIN_PRVDRV=y
	help
		This integrates vcodec driver to linux kernel.
	default n

config AXERA_BUILDIN_PRVDRV_JENC
	bool "integrates ax_jenc driver to linux kernel"
	depends on AXERA_BUILDIN_PRVDRV=y && AXERA_BUILDIN_PRVDRV_VCODEC=y
	help
		This integrates ax_jenc driver to linux kernel.
	default n

config AXERA_BUILDIN_PRVDRV_VENC
	bool "integrates ax_venc driver to linux kernel"
	depends on AXERA_BUILDIN_PRVDRV=y && AXERA_BUILDIN_PRVDRV_VCODEC=y
	help
		This integrates ax_venc driver to linux kernel.
	default n

config AXERA_BUILDIN_PRVDRV_VDEC
	bool "integrates ax_vdec driver to linux kernel"
	depends on AXERA_BUILDIN_PRVDRV=y && AXERA_BUILDIN_PRVDRV_VCODEC=y
	help
		This integrates ax_vdec driver to linux kernel.
	default n

config AXERA_BUILDIN_PRVDRV_IVE
	bool "integrates ax_ive driver to linux kernel"
	depends on AXERA_BUILDIN_PRVDRV=y
	help
		This integrates ax_ive driver to linux kernel.
	default n

config AXERA_BUILDIN_PRVDRV_AVS
	bool "integrates ax_avs driver to linux kernel"
	depends on AXERA_BUILDIN_PRVDRV=y
	help
		This integrates ax_avs driver to linux kernel.
	default n

config AXERA_BUILDIN_PRVDRV_DDR_DFS
	bool "integrates ax_ddr_dfs driver to linux kernel"
	depends on AXERA_BUILDIN_PRVDRV=y
	help
		This integrates ax_ddr_dfs driver to linux kernel.
	default n

config AXERA_BUILDIN_PRVDRV_AUDIO
	bool "integrates ax_audio driver to linux kernel"
	depends on AXERA_BUILDIN_PRVDRV=y
	help
		This integrates ax_audio driver to linux kernel.
	default n

config AXERA_BUILDIN_PRVDRV_VFB
	bool "integrates ax_vfb driver to linux kernel"
	depends on AXERA_BUILDIN_PRVDRV=y
	help
		This integrates ax_vfb driver to linux kernel.
	default n

config AX_DEBUG_BOOT_TIME
	bool "AX BOOT TIME DEBUG"
	help
		This enable AXERA BOOT TIME DEBUG.

config AXERA_ISP_IMAGE_MEM_RECYCLE
	bool "recycle ISP image memory in fast boot mode"
	default n
	help
	  If this is set, the memory of ISP image will be recycle to use after system boot.

config AXERA_CMM_MEM_RECYCLE
	bool "recycle CMM memory to OS"
	default n
	help
	  If this is set, the memory of CMM can be recycle to OS.

config AX_RISCV_SUPPORT
	bool "for fast project"
	default n
	help
	  for fast project.
```

## drivers/video/fbdev/sunxi/disp2/disp/Kconfig
```kconfig
config DISP2_SUNXI_SUPPORT_LCD
	bool "Support LCD"
	default y
	---help---
		If you want to support LCD, select it.

config DISP2_SUNXI_SUPPORT_DSI
	bool "Support DSI"
	depends on DISP2_SUNXI_SUPPORT_LCD
	default y
	---help---
		If you want to support DSI, select it.

config DISP2_SUNXI_SUPPORT_LVDS
	bool "Support LVDS"
	depends on DISP2_SUNXI_SUPPORT_LCD
	default y
	---help---
		If you want to support LVDS, select it.

config DISP2_SUNXI_SUPPORT_HDMI
	bool "Support HDMI"
	default y
	---help---
		If you want to support HDMI, select it.

config DISP2_SUNXI_SUPPORT_TV
	bool "Support TV"
	default y
	---help---
		If you want to support TV, select it.

config DISP2_SUNXI_SUPPORT_VDEVICE
	bool "Support VDEVICE"
	depends on DISP2_SUNXI_SUPPORT_LCD
	default y
	---help---
		If you want to support VDEVICE, select it.

config DISP2_SUNXI_SUPPORT_VGA
	bool "Support VGA"
	default y
	---help---
		If you want to support VGA, select it.

config DISP2_SUNXI_SUPPORT_EDP
	bool "Support EDP"
	default y
	---help---
		If you want to support EDP, select it.

config DISP2_SUNXI_SUPPORT_RTWB
	bool "Support RTWB"
	default y
	---help---
		If you want to support RTWB, select it.

config DISP2_SUNXI_SUPPORT_SMBL
	bool "Support smart backlight"
	default y
	---help---
		If you want to support smart backlight, select it.

config DISP2_SUNXI_SUPPORT_ENAHNCE
	bool "Support Video Enhance Process"
	default y
	---help---
		If you want to support video enhance process, select it.

config DISP2_SUNXI_SUPPORT_CAPTURE
	bool "Support capture"
	default y
	---help---
		If you want to support capture, select it.
```

## scripts/axera/AX620E_buildin_prvdrv_defconfig
```kconfig
CONFIG_AXERA_BUILDIN_PRVDRV=y
CONFIG_AXERA_BUILDIN_PRVDRV_CMM=y
CONFIG_AXERA_BUILDIN_PRVDRV_SYS=y
CONFIG_AXERA_BUILDIN_PRVDRV_POOL=y
CONFIG_AXERA_BUILDIN_PRVDRV_BASE=y
CONFIG_AXERA_BUILDIN_PRVDRV_MIPI_RX=y
CONFIG_AXERA_BUILDIN_PRVDRV_NPU=y
CONFIG_AXERA_BUILDIN_PRVDRV_VO=y
CONFIG_AXERA_BUILDIN_PRVDRV_IVPS=y
CONFIG_AXERA_BUILDIN_PRVDRV_VPP=y
CONFIG_AXERA_BUILDIN_PRVDRV_GDC=y
CONFIG_AXERA_BUILDIN_PRVDRV_TDP=y
CONFIG_AXERA_BUILDIN_PRVDRV_ISP=y
CONFIG_AXERA_BUILDIN_PRVDRV_MIPI_SWITCH=y
CONFIG_AXERA_BUILDIN_PRVDRV_VCODEC=y
CONFIG_AXERA_BUILDIN_PRVDRV_JENC=y
CONFIG_AXERA_BUILDIN_PRVDRV_VENC=y
CONFIG_AXERA_BUILDIN_PRVDRV_VDEC=y
CONFIG_AXERA_BUILDIN_PRVDRV_IVE=y
CONFIG_AXERA_BUILDIN_PRVDRV_AVS=y
CONFIG_AXERA_BUILDIN_PRVDRV_DDR_DFS=y
CONFIG_AXERA_BUILDIN_PRVDRV_AUDIO=y
CONFIG_AXERA_BUILDIN_PRVDRV_VFB=y
```

## scripts/axera/AX620E_debug_defconfig
```kconfig
# axera kernel debugging configs

### Kernel Memory Leak Detector (KMEMLEAK)
CONFIG_DEBUG_KMEMLEAK=y

### The Kernel Address Sanitizer (KASAN)
CONFIG_KASAN=y

### The Kernel Concurrency Sanitizer (KCSAN)
CONFIG_KCSAN=y

### The Undefined Behavior Sanitizer - UBSAN
CONFIG_UBSAN=y
CONFIG_UBSAN_SANITIZE_ALL=y

### Slub Debug
# DO NOT support slub debug by default, because it conflicts with KASAN
# CONFIG_SLUB=y
# CONFIG_SLUB_DEBUG=y
# CONFIG_SLUB_DEBUG_ON=y

### lockdep
CONFIG_PROVE_LOCKING=y
CONFIG_DEBUG_LOCK_ALLOC=y
CONFIG_LOCK_STAT=y
CONFIG_DEBUG_LOCKDEP=y
CONFIG_DEBUG_SPINLOCK=y
CONFIG_DEBUG_MUTEXES=y
CONFIG_DEBUG_ATOMIC_SLEEP=y
CONFIG_DEBUG_LOCKING_API_SELFTESTS=y

### Stack overflow check
CONFIG_SCHED_STACK_END_CHECK=y

### disable stack frame check
CONFIG_FRAME_WARN=0
```

## scripts/axera/AX620E_kmemleak_defconfig
```kconfig
### Kernel Memory Leak Detector (KMEMLEAK)
CONFIG_HAVE_DEBUG_KMEMLEAK=y
CONFIG_DEBUG_KMEMLEAK=y
CONFIG_DEBUG_KMEMLEAK_MEM_POOL_SIZE=16000
CONFIG_DEBUG_KMEMLEAK_AUTO_SCAN=y
```
