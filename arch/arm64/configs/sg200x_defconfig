## arch/riscv/Kconfig.socs
```kconfig
menu "SoC selection"

config ARCH_MICROCHIP_POLARFIRE
	def_bool SOC_MICROCHIP_POLARFIRE

config SOC_MICROCHIP_POLARFIRE
	bool "Microchip PolarFire SoCs"
	help
	  This enables support for Microchip PolarFire SoC platforms.

config ARCH_RENESAS
	bool "Renesas RISC-V SoCs"
	help
	  This enables support for the RISC-V based Renesas SoCs.

config ARCH_SIFIVE
	def_bool SOC_SIFIVE

config SOC_SIFIVE
	bool "SiFive SoCs"
	select ERRATA_SIFIVE if !XIP_KERNEL
	help
	  This enables support for SiFive SoC platform hardware.

config ARCH_STARFIVE
	def_bool SOC_STARFIVE

config SOC_STARFIVE
	bool "StarFive SoCs"
	select PINCTRL
	select RESET_CONTROLLER
	select ARM_AMBA
	help
	  This enables support for StarFive SoC platform hardware.

config RISCV_SUNXI
	bool

config ARCH_SUNXI
	bool "Allwinner sun20i SoCs"
	depends on MMU && !XIP_KERNEL
	select ERRATA_THEAD
	select SUN4I_TIMER
	select RISCV_EARLY_VA
	select RISCV_SUNXI
	select CPU_PM if CPU_IDLE
	help
	  This enables support for Allwinner sun20i platform hardware,
	  including boards based on the D1 and D1s SoCs.

# Select the board between FPGA and EVB

choice
      prompt "Allwinner development Board"
      depends on ARCH_SUNXI
      default FPGA_V4_PLATFORM

config FPGA_V4_PLATFORM
       bool "FPGAv4 board"
       help
         Support for Allwinner's FPGAv4 board

config FPGA_V7_PLATFORM
       bool "FPGAv7 board"
       help
         Support for Allwinner's FPGAv4 board

config EVB_PLATFORM
       bool "EVB board"
       help
         Support for Allwinner's EVB board
endchoice

if ARCH_SUNXI
choice
	prompt "Select the architecture of SoC"
	default ARCH_SUN20I
	help
	  Select the architecture for SoC
	  sunxi
	  `-- sun20i ----- C906 based Family SoCs

	config ARCH_SUN20I
	bool "Allwinner SUN20I"
endchoice

if ARCH_SUN20I
choice
	prompt "Select the wafer with arch sun20i"
	default ARCH_SUN20IW1
	help
	  Select the wafer with arch sun20i

config ARCH_SUN20IW1
	bool "Allwinner SUN20IW1 SoCs"
	help
	  Support for Allwinner SUN20IW1 SoC family

endchoice
endif

if ARCH_SUN20IW1
choice
	prompt "Select the wafer with arch sun20iw1"
	default ARCH_SUN20IW1P1
	help
	  Select the wafer with arch sun20iw1

config ARCH_SUN20IW1P1
	bool "Allwinner SUN20IW1P1 SoCs"
	help
	  Support for Allwinner SUN20IW1P1 SoC family

endchoice
endif
endif

config ARCH_THEAD
	bool "T-HEAD RISC-V SoCs"
	depends on MMU && !XIP_KERNEL
	select ERRATA_THEAD
	help
	  This enables support for the RISC-V based T-HEAD SoCs.

config ARCH_VIRT
	def_bool SOC_VIRT

config SOC_VIRT
	bool "QEMU Virt Machine"
	select CLINT_TIMER if RISCV_M_MODE
	select POWER_RESET
	select POWER_RESET_SYSCON
	select POWER_RESET_SYSCON_POWEROFF
	select GOLDFISH
	select RTC_DRV_GOLDFISH if RTC_CLASS
	select PM_GENERIC_DOMAINS if PM
	select PM_GENERIC_DOMAINS_OF if PM && OF
	select RISCV_SBI_CPUIDLE if CPU_IDLE && RISCV_SBI
	help
	  This enables support for QEMU Virt Machine.

config ARCH_CANAAN
	def_bool SOC_CANAAN

config SOC_CANAAN
	bool "Canaan Kendryte K210 SoC"
	depends on !MMU
	select CLINT_TIMER if RISCV_M_MODE
	select ARCH_HAS_RESET_CONTROLLER
	select PINCTRL
	select COMMON_CLK
	help
	  This enables support for Canaan Kendryte K210 SoC platform hardware.

if ARCH_CANAAN

config ARCH_CANAAN_K210_DTB_BUILTIN
	def_bool SOC_CANAAN_K210_DTB_BUILTIN

config SOC_CANAAN_K210_DTB_BUILTIN
	bool "Builtin device tree for the Canaan Kendryte K210"
	depends on ARCH_CANAAN
	default y
	select OF
	select BUILTIN_DTB
	help
	  Build a device tree for the Kendryte K210 into the Linux image.
	  This option should be selected if no bootloader is being used.
	  If unsure, say Y.

config ARCH_CANAAN_K210_DTB_SOURCE
	string
	default SOC_CANAAN_K210_DTB_SOURCE

config SOC_CANAAN_K210_DTB_SOURCE
	string "Source file for the Canaan Kendryte K210 builtin DTB"
	depends on ARCH_CANAAN
	depends on ARCH_CANAAN_K210_DTB_BUILTIN
	default "k210_generic"
	help
	  Base name (without suffix, relative to arch/riscv/boot/dts/canaan)
	  for the DTS file that will be used to produce the DTB linked into the
	  kernel.

endif # ARCH_CANAAN

config ARCH_CVITEK
	bool "CVITEK SoCs"
	help
	  This enables support for cvitek SoC platform hardware.

config SOC_THEAD
	bool "T-HEAD SoCs"
	help
	  This enables support for T-HEAD SoC platform hardware.

endmenu # "SoC selection"
```

## drivers/soc/rockchip/Kconfig
```kconfig
# SPDX-License-Identifier: GPL-2.0-only
if ARCH_ROCKCHIP || COMPILE_TEST

source "drivers/soc/rockchip/Kconfig.cpu"

#
# Rockchip Android Features
#

config NO_GKI
	bool "Disable Android GKI support"
	default y if !GKI_HACKS_TO_FIX
	help
	  Say y here to disable Android GKI support. Then
	  all the ABI compatibilities are not applicable.

	  If unsure, say Y.

#
# Rockchip Soc drivers
#
config ROCKCHIP_CPUINFO
	tristate "Rockchip cpuinfo support"
	depends on (NVMEM_ROCKCHIP_EFUSE || NVMEM_ROCKCHIP_OTP) && (ARM64 || ARM)
	default y
	help
	  Say y here to enable Rockchip cpuinfo support.
	  Set system_serial_low/high from eFuse ID.
	  Serial can read from /proc/cpuinfo.

	  If unsure, say N.

config ROCKCHIP_GRF
	tristate "Rockchip GRF"
	help
	  The General Register Files are a central component providing
	  special additional settings registers for a lot of soc-components.
	  In a lot of cases there also need to be default settings initialized
	  to make some of them conform to expectations of the kernel.

config ROCKCHIP_HW_DECOMPRESS
	bool "Rockchip HardWare Decompress Support"
	help
	  This driver support Decompress IP built-in Rockchip SoC, support
	  LZ4, GZIP, ZLIB.

config ROCKCHIP_IODOMAIN
	tristate "Rockchip IO domain support"
	depends on OF
	help
	  Say y here to enable support io domains on Rockchip SoCs. It is
	  necessary for the io domain setting of the SoC to match the
	  voltage supplied by the regulators.

config ROCKCHIP_DTPM
	tristate "Rockchip DTPM hierarchy"
	depends on DTPM && m
	help
	  Describe the hierarchy for the Dynamic Thermal Power Management tree
	  on this platform. That will create all the power capping capable
	  devices.

endif
```

## drivers/usb/Kconfig
```kconfig
# SPDX-License-Identifier: GPL-2.0
#
# USB device configuration
#

config USB_OHCI_BIG_ENDIAN_DESC
	bool

config USB_OHCI_BIG_ENDIAN_MMIO
	bool

config USB_OHCI_LITTLE_ENDIAN
	bool
	default n if PPC_MPC52xx
	default y

config USB_EHCI_BIG_ENDIAN_MMIO
	bool

config USB_EHCI_BIG_ENDIAN_DESC
	bool

config USB_UHCI_BIG_ENDIAN_MMIO
	bool

config USB_UHCI_BIG_ENDIAN_DESC
	bool

menuconfig USB_SUPPORT
	bool "USB support"
	depends on HAS_IOMEM
	default y
	help
	  This option adds core support for Universal Serial Bus (USB).
	  You will also need drivers from the following menu to make use of it.

if USB_SUPPORT

source "drivers/usb/common/Kconfig"

config USB_ARCH_HAS_HCD
	def_bool y

config USB
	tristate "Support for Host-side USB"
	depends on USB_ARCH_HAS_HCD
	select GENERIC_ALLOCATOR
	select USB_COMMON
	select NLS  # for UTF-8 strings
	help
	  Universal Serial Bus (USB) is a specification for a serial bus
	  subsystem which offers higher speeds and more features than the
	  traditional PC serial port.  The bus supplies power to peripherals
	  and allows for hot swapping.  Up to 127 USB peripherals can be
	  connected to a single USB host in a tree structure.
	  
	  The USB host is the root of the tree, the peripherals are the
	  leaves and the inner nodes are special USB devices called hubs.
	  Most PCs now have USB host ports, used to connect peripherals
	  such as scanners, keyboards, mice, modems, cameras, disks,
	  flash memory, network links, and printers to the PC.

	  Say Y here if your computer has a host-side USB port and you want
	  to use USB devices.  You then need to say Y to at least one of the
	  Host Controller Driver (HCD) options below.  Choose a USB 1.1
	  controller, such as "UHCI HCD support" or "OHCI HCD support",
	  and "EHCI HCD (USB 2.0) support" except for older systems that
	  do not have USB 2.0 support.  It doesn't normally hurt to select
	  them all if you are not certain.

	  If your system has a device-side USB port, used in the peripheral
	  side of the USB protocol, see the "USB Gadget" framework instead.

	  After choosing your HCD, then select drivers for the USB peripherals
	  you'll be using.  You may want to check out the information provided
	  in <file:Documentation/usb/> and especially the links given in
	  <file:Documentation/usb/usb-help.rst>.

	  To compile this driver as a module, choose M here: the
	  module will be called usbcore.

config USB_PCI
	bool "PCI based USB host interface"
	depends on PCI
	default y
	help
	  Many embedded system SOCs (e.g. freescale T2080) have both
	  PCI and USB modules with the USB module directly controlled by
	  registers and having no relationship to the PCI module.

	  If you have such a device you may say N here and PCI related code
	  will not be built in the USB driver.

config USB_PCI_AMD
	bool "AMD PCI USB host support"
	depends on USB_PCI && HAS_IOPORT
	default X86 || MACH_LOONGSON64 || PPC_PASEMI
	help
	  Enable workarounds for USB implementation quirks in SB600/SB700/SB800
	  and later south bridge implementations. These are common on x86 PCs
	  with AMD CPUs but rarely used elsewhere, with the exception of a few
	  powerpc and mips desktop machines.

if USB

source "drivers/usb/core/Kconfig"

source "drivers/usb/mon/Kconfig"

source "drivers/usb/host/Kconfig"

source "drivers/usb/renesas_usbhs/Kconfig"

source "drivers/usb/class/Kconfig"

source "drivers/usb/storage/Kconfig"

source "drivers/usb/image/Kconfig"

source "drivers/usb/usbip/Kconfig"

endif

comment "USB dual-mode controller drivers"

source "drivers/usb/cdns3/Kconfig"

source "drivers/usb/fotg210/Kconfig"

source "drivers/usb/mtu3/Kconfig"

source "drivers/usb/musb/Kconfig"

source "drivers/usb/dwc3/Kconfig"

source "drivers/usb/dwc2/Kconfig"

source "drivers/usb/chipidea/Kconfig"

source "drivers/usb/isp1760/Kconfig"

config USB_CVITEK_DRD
	tristate "Cvitek USB DRD Core Support"
	depends on USB && HAS_DMA
	select USB_XHCI_PLATFORM if USB_SUPPORT && USB_XHCI_HCD
	help
	  Say Y or M here if your system has a Dual Role SuperSpeed
	  USB controller based on the Cvitek USB3 IP Core.

	  If you choose to build this driver is a dynamically linked
	  module, the module will be called cviusb_drd.ko.

if USB_CVITEK_DRD

config USB_CVITEK_MISC
	bool "Additional miscellaneous device for ioctl"
	depends on (USB=y || USB=USB_CVITEK_DRD)
	help
	  Select this if you want to send commands to driver
	  using I/O control.

	  The miscellaneous function includes the drd state
	  configuration and gadget standby mode.

endif

config USB_CVITEK_GADGET
	tristate "Cvitek device controller"
	depends on USB_GADGET
	help
	  Bitmain device controller driver for CV183X.
	  BM1880 USB device can support USB 2.0 high speed.

	  Say 'Y' or 'M' here to enable device controller functionality
	  of the Cvitek driver.

comment "Platform Glue Driver Support"

comment "USB port drivers"

if USB

source "drivers/usb/serial/Kconfig"

source "drivers/usb/misc/Kconfig"

source "drivers/usb/atm/Kconfig"

endif # USB

source "drivers/usb/phy/Kconfig"

source "drivers/usb/gadget/Kconfig"

source "drivers/usb/typec/Kconfig"

source "drivers/usb/roles/Kconfig"

endif # USB_SUPPORT
```
